## configs/radxa-cubie-a7a_defconfig
```kconfig
CONFIG_ARM=y
CONFIG_ARCH_SUNXI=y
CONFIG_HAS_CUSTOM_SYS_INIT_SP_ADDR=y
CONFIG_CUSTOM_SYS_INIT_SP_ADDR=0x4F000000
CONFIG_DEFAULT_DEVICE_TREE="sun60i-a733-radxa-a7a"
CONFIG_SPL=y
CONFIG_MACH_SUN60I_A733=y
CONFIG_MMC_SUNXI_SLOT_EXTRA=2
# CONFIG_SYS_MALLOC_CLEAR_ON_INIT is not set
CONFIG_SPL_LOAD_FIT_ADDRESS=0x48200000
CONFIG_BOOTDELAY=3
CONFIG_SPL_RAM_DEVICE=y
CONFIG_CMD_DFU=y
CONFIG_CMD_I2C=y
CONFIG_CMD_SF_TEST=y
CONFIG_CMD_SPI=y
CONFIG_NET_RANDOM_ETHADDR=y
CONFIG_SYS_I2C_MVTWSI=y
CONFIG_SUPPORT_EMMC_BOOT=y
CONFIG_MTD=y
CONFIG_SPI_FLASH_SOFT_RESET=y
CONFIG_SPI_FLASH_SOFT_RESET_ON_BOOT=y
CONFIG_SPI_FLASH_MACRONIX=y
CONFIG_SPI_FLASH_SPANSION=y
CONFIG_SPI_FLASH_STMICRO=y
CONFIG_SPI_FLASH_SST=y
CONFIG_SPI_FLASH_WINBOND=y
CONFIG_SPI_FLASH_DATAFLASH=y
CONFIG_SPI_FLASH_MTD=y
CONFIG_DM_MDIO=y
CONFIG_DM_ETH_PHY=y
CONFIG_DWC_ETH_QOS=y
CONFIG_DWC_ETH_QOS_SUNXI=y
CONFIG_RGMII=y
CONFIG_RMII=y
CONFIG_REGULATOR_AXP=y
CONFIG_SPI=y
# CONFIG_SYSRESET is not set
CONFIG_USB_EHCI_HCD=y
CONFIG_USB_OHCI_HCD=y
CONFIG_USB_MUSB_GADGET=y
CONFIG_USB_ETH_CDC=y
```
