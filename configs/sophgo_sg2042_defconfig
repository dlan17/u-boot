## configs/sophgo_sg2042_defconfig
```kconfig
CONFIG_RISCV=y
CONFIG_SKIP_LOWLEVEL_INIT=y
CONFIG_SYS_MALLOC_LEN=0x800000
CONFIG_SYS_MALLOC_F_LEN=0x3000
CONFIG_HAS_CUSTOM_SYS_INIT_SP_ADDR=y
CONFIG_CUSTOM_SYS_INIT_SP_ADDR=0x80200000
CONFIG_DEFAULT_DEVICE_TREE="sophgo-sg2042-a00"
CONFIG_SYS_LOAD_ADDR=0x80200000
CONFIG_TARGET_SOPHGO_SG2042=y
CONFIG_ARCH_RV64I=y
CONFIG_RISCV_SMODE=y
CONFIG_FIT=y
CONFIG_OF_BOARD_SETUP=y
# CONFIG_ARCH_FIXUP_FDT_MEMORY is not set
CONFIG_DISTRO_DEFAULTS=y
CONFIG_DEFAULT_FDT_FILE="sophgo/sophgo-sg2042-a00.dtb"
CONFIG_DISPLAY_CPUINFO=y
CONFIG_DISPLAY_BOARDINFO=y
CONFIG_DISPLAY_BOARDINFO_LATE=y
CONFIG_SYS_CBSIZE=256
CONFIG_SYS_PBSIZE=276
CONFIG_SYS_BOOTM_LEN=0x4000000
CONFIG_CMD_MEMINFO=y
CONFIG_CMD_MMC=y
CONFIG_MMC=y
CONFIG_MMC_SDHCI=y
CONFIG_MMC_SDHCI_SOPHGO=y
CONFIG_SYS_NS16550=y
CONFIG_EXT4_WRITE=y
CONFIG_BZIP2=y
CONFIG_ZSTD=y
```
